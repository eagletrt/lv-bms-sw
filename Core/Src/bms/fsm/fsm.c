/******************************************************************************
Finite State Machine
Project: assets/fsm/fsm.dot
Description: gv_fsm example

Generated by gv_fsm ruby gem, see https://rubygems.org/gems/gv_fsm
gv_fsm version 0.5.2
Generation date: 2026-04-27 14:29:37 +0200
Generated from: assets/fsm/fsm.dot
The finite state machine has:
  5 states
  10 transition functions

******************************************************************************/

#include "fsm.h"

// SEARCH FOR Your Code Here FOR CODE INSERTION POINTS!
#include <stdint.h>
#include <stdio.h>

#include "eagletrt-api.h"
#include "bms-monitor-fsm.h"
#include "can-communication-api.h"
#include "identity-api.h"
#include "can-primary.h"
#include "post-api.h"
#include "eagletrt.h"
#include "post.h"
#include "logger-api.h"
#include "bms-monitor-api.h"
#include "balancing-api.h"
#include "current-api.h"
#include "voltage-api.h"
#include "temperature-api.h"
#include "feedback-api.h"
#include "defines.h"

/*!
 * \brief            Consecutive healthy checks required before the relay is closed.
 *
 * \details          A fault opens the output on the very first bad check, but closing it
 *                   again waits for the pack to look good several times running. The
 *                   asymmetry is deliberate: K1 is a mechanical relay and chattering it on
 *                   a marginal reading would wear the contacts.
 */
constexpr uint8_t fsm_relay_close_confirmations = 3U;

EAGLETRT_STATIC bms_monitor_fsm_state_t bms_monitor_fsm_state = BMS_MONITOR_FSM_STATE_INIT;

/*!
 * \brief            Board services handed to the FSM at init, plus the relay supervision state.
 *
 * \details          Nothing under Core/{Inc,Src}/bms may include the HAL, so the FSM
 *                   reaches the ADC, the relay and the board measurements only through the
 *                   callbacks. They are captured once in do_init() because the later states
 *                   receive a struct FsmData, not the init data.
 */
EAGLETRT_STATIC struct FsmRelayHandler fsm_relay = { 0 };

/*!
 * \brief            Open or close the master relay, tolerating a board that never supplied
 *                   the callback.
 *
 * \param[in]        closed True to connect the output.
 */
EAGLETRT_STATIC void prv_fsm_drive_master_relay(bool closed) {
    if (fsm_relay.set_master_relay != NULL) {
        fsm_relay.set_master_relay(closed);
    }
}

/*!
 * \brief            Reason the master relay may not be closed.
 */
enum FsmSafetyStatus {
    FSM_SAFETY_OK = 0,              /*!< Every enabled check passed */
    FSM_SAFETY_VOLTAGE_UNAVAILABLE, /*!< The voltage module could not be read */
    FSM_SAFETY_VOLTAGE_RANGE,       /*!< At least one cell is outside its limits */
    FSM_SAFETY_CELL_DELTA,          /*!< The pack is too imbalanced to discharge */
    FSM_SAFETY_OPEN_WIRE,           /*!< The open-wire check flagged a cell */
    FSM_SAFETY_NTC_FAULT,           /*!< An NTC channel is open or shorted */
    FSM_SAFETY_TEMPERATURE_RANGE    /*!< The pack is outside its temperature limits */
};

/*!
 * \brief            Human-readable form of a safety status, for the log.
 */
EAGLETRT_STATIC const char *prv_fsm_safety_status_name(enum FsmSafetyStatus status) {
    switch (status) {
        case FSM_SAFETY_OK:
            return "ok";
        case FSM_SAFETY_VOLTAGE_UNAVAILABLE:
            return "no voltage data";
        case FSM_SAFETY_VOLTAGE_RANGE:
            return "cell voltage";
        case FSM_SAFETY_CELL_DELTA:
            return "cell delta";
        case FSM_SAFETY_OPEN_WIRE:
            return "open wire";
        case FSM_SAFETY_NTC_FAULT:
            return "NTC fault";
        case FSM_SAFETY_TEMPERATURE_RANGE:
            return "temperature";
        default:
            return "unknown";
    }
}

/*!
 * \brief            Decide whether the pack is in a state that allows closing the master relay.
 *
 * \details          Runs on every supervision tick, so it does not log: the caller logs
 *                   only when the verdict changes, otherwise a standing fault would flood
 *                   the serial link and, since the logger transmits blocking, stall the
 *                   main loop.
 *
 * \returns          enum FsmSafetyStatus FSM_SAFETY_OK when the relay may be closed,
 *                   otherwise the first condition that failed.
 */
EAGLETRT_STATIC enum FsmSafetyStatus prv_fsm_check_pack_safety(void) {
    volt voltages[DEFINES_CELLS_SERIES_COUNT] = { 0.F };
    if (voltage_api_dump_voltages(voltages, 0U, DEFINES_CELLS_SERIES_COUNT) != VOLTAGE_RC_OK) {
        return FSM_SAFETY_VOLTAGE_UNAVAILABLE;
    }

    for (size_t i = 0U; i < DEFINES_CELLS_SERIES_COUNT; ++i) {
        if (voltages[i] < VOLTAGE_MIN_V || voltages[i] > VOLTAGE_MAX_V) {
            return FSM_SAFETY_VOLTAGE_RANGE;
        }
    }

    if ((voltage_api_get_max() - voltage_api_get_min()) > VOLTAGE_CELL_DELTA_MAX_V) {
        return FSM_SAFETY_CELL_DELTA;
    }

    if (bms_monitor_api_check_open_wire() != 0U) {
        return FSM_SAFETY_OPEN_WIRE;
    }

    const celsius t_max = temperature_api_get_max();
    if (t_max > TEMPERATURE_DISCHARGE_MAX_C) {
        return FSM_SAFETY_TEMPERATURE_RANGE;
    }

    return FSM_SAFETY_OK;
}

/*!
 * \brief            Supervise the master relay against the state of the pack.
 *
 * \details          Called from idle on its own 50 ms cycle. A fault opens the
 *                   output straight away; closing it again needs
 *                   #fsm_relay_close_confirmations healthy checks; the verdict is
 *                   logged only when it changes. First reads are 0 V so the relay
 *                   stays open until real data.
 */
void fsm_relay_supervise(void) {
    static enum FsmSafetyStatus last_status = FSM_SAFETY_OK;
    const enum FsmSafetyStatus status = prv_fsm_check_pack_safety();

    if (status != last_status) {
        last_status = status;
        logger_api_log(LOGGER_LEVEL_INFO, "[SAFE] %s", prv_fsm_safety_status_name(status));
    }
    if (status != FSM_SAFETY_OK) {
        fsm_relay.good_streak = 0U;
        if (fsm_relay.closed) {
            fsm_relay.closed = false;
            prv_fsm_drive_master_relay(false);
            logger_api_log(LOGGER_LEVEL_WARN, "[SAFE] relay opened");
        }
        return;
    }

    if (fsm_relay.good_streak < fsm_relay_close_confirmations) {
        ++fsm_relay.good_streak;
        return;
    }

    if (!fsm_relay.closed) {
        fsm_relay.closed = true;
        prv_fsm_drive_master_relay(true);
        logger_api_log(LOGGER_LEVEL_INFO, "[SAFE] relay closed");
    }
}

void fsm_monitor_step(void) {
    bms_monitor_fsm_state = bms_monitor_fsm_run_state(bms_monitor_fsm_state, NULL);
}

// GLOBALS
// State human-readable names
__attribute__((unused))
const char *state_names[] = { "init", "idle", "fatal", "flash", "balancing" };

// List of state functions
state_func_t *const state_table[NUM_STATES] = {
    do_init,      // in state init
    do_idle,      // in state idle
    do_fatal,     // in state fatal
    do_flash,     // in state flash
    do_balancing, // in state balancing
};

// Table of transition functions
transition_func_t *const transition_table[NUM_STATES][NUM_STATES] = {
    /* states:       init              , idle              , fatal             , flash             , balancing          */
    /* init      */ { NULL, init_to_idle, init_to_fatal, NULL, NULL },
    /* idle      */ { NULL, NULL, idle_to_fatal, idle_to_flash, idle_to_balancing },
    /* fatal     */ { NULL, NULL, NULL, fatal_to_flash, NULL },
    /* flash     */ { NULL, flash_to_idle, flash_to_fatal, NULL, NULL },
    /* balancing */ { NULL, balancing_to_idle, balancing_to_fatal, NULL, NULL },
};

/*  ____  _        _
 * / ___|| |_ __ _| |_ ___
 * \___ \| __/ _` | __/ _ \
 *  ___) | || (_| | ||  __/
 * |____/ \__\__,_|\__\___|
 *
 *   __                  _   _
 *  / _|_   _ _ __   ___| |_(_) ___  _ __  ___
 * | |_| | | | '_ \ / __| __| |/ _ \| '_ \/ __|
 * |  _| |_| | | | | (__| |_| | (_) | | | \__ \
 * |_|  \__,_|_| |_|\___|\__|_|\___/|_| |_|___/
 */

// Function to be executed in state init
// valid return states: STATE_IDLE, STATE_FATAL
state_t do_init(state_data_t *data) {
    state_t next_state = STATE_IDLE;
    /* Your Code Here */
    struct PostInitData *fsm_init_data = (struct PostInitData *)data;

    logger_api_log(LOGGER_LEVEL_INFO, "[FSM] do_init: running POST");
    const enum PostReturnCode post_rc = post_api_run(fsm_init_data);
    if (post_rc != POST_RC_OK) {
        logger_api_log(LOGGER_LEVEL_ERROR, "[FSM] POST failed rc=%d -> FATAL", (int)post_rc);
        next_state = STATE_FATAL;
    } else {
        logger_api_log(LOGGER_LEVEL_INFO, "[FSM] POST ok");
    }

    /*! Capture the board services before any state reaches for them. */
    fsm_relay.set_master_relay = fsm_init_data->set_master_relay;
    fsm_relay.read_measurements = fsm_init_data->read_board_measurements;

    if (fsm_relay.set_master_relay == NULL) {
        /*! A board that cannot command its own relay is misbuilt; say so loudly
            rather than running on with an output that can never close. */
        logger_api_log(LOGGER_LEVEL_ERROR, "[FSM] no relay callback -> FATAL");
        next_state = STATE_FATAL;
    }

    identity_api_send_state(CAN_PRIMARY_LVACFSM_STATUS_INIT);
    bms_monitor_fsm_state = bms_monitor_fsm_run_state(BMS_MONITOR_FSM_STATE_INIT, nullptr);
    logger_api_log(LOGGER_LEVEL_INFO, "[FSM] monitor fsm primed, state=%d", (int)bms_monitor_fsm_state);

    /*! Leave init with the output open. Idle brings it up once it has seen real
        measurements, and takes it back down if they go bad. */
    prv_fsm_drive_master_relay(false);
    fsm_relay.closed = false;
    fsm_relay.good_streak = 0U;

    switch (next_state) {
        case STATE_IDLE:
        case STATE_FATAL:
            break;
        default:
            next_state = NO_CHANGE;
    }

    return next_state;
}

// Function to be executed in state idle
// valid return states: NO_CHANGE, STATE_FLASH, STATE_IDLE, STATE_BALANCING, STATE_FATAL
state_t do_idle(state_data_t *data) {
    state_t next_state = NO_CHANGE;
    /* Your Code Here */
    EAGLETRT_API_UNUSED(data);

    /* Hold the output closed only while the pack keeps checking out. */
    can_communication_api_process_rx(CAN_COMMUNICATION_NETWORK_PRIMARY);

    can_communication_api_process_tx(CAN_COMMUNICATION_NETWORK_PRIMARY);

    if (balancing_api_is_active()) {
        next_state = STATE_BALANCING;
    }

    switch (next_state) {
        case NO_CHANGE:
        case STATE_FLASH:
        case STATE_IDLE:
        case STATE_BALANCING:
        case STATE_FATAL:
            break;
        default:
            next_state = NO_CHANGE;
    }

    return next_state;
}

// Function to be executed in state fatal
// valid return states: NO_CHANGE, STATE_FLASH, STATE_FATAL
state_t do_fatal(state_data_t *data) {
    state_t next_state = NO_CHANGE;
    /* Your Code Here */
    EAGLETRT_API_UNUSED(data);

    /*! Whatever route led here, the output must not stay live. Held low every
        cycle rather than only on entry, so a glitch on the pin is corrected. */
    prv_fsm_drive_master_relay(false);
    fsm_relay.closed = false;
    fsm_relay.good_streak = 0U;

    switch (next_state) {
        case NO_CHANGE:
        case STATE_FLASH:
        case STATE_FATAL:
            break;
        default:
            next_state = NO_CHANGE;
    }

    return next_state;
}

// Function to be executed in state flash
// valid return states: STATE_IDLE, STATE_FATAL
state_t do_flash(state_data_t *data) {
    state_t next_state = STATE_IDLE;
    /* Your Code Here */
    EAGLETRT_API_UNUSED(data);

    switch (next_state) {
        case STATE_IDLE:
        case STATE_FATAL:
            break;
        default:
            next_state = NO_CHANGE;
    }

    return next_state;
}

// Function to be executed in state balancing
// valid return states: NO_CHANGE, STATE_IDLE, STATE_BALANCING, STATE_FATAL
state_t do_balancing(state_data_t *data) {
    state_t next_state = NO_CHANGE;
    /* Your Code Here */
    EAGLETRT_API_UNUSED(data);

    can_communication_api_process_rx(CAN_COMMUNICATION_NETWORK_PRIMARY);

    can_communication_api_process_tx(CAN_COMMUNICATION_NETWORK_PRIMARY);

    if (!balancing_api_is_active()) {
        next_state = STATE_IDLE;
    }

    switch (next_state) {
        case NO_CHANGE:
        case STATE_IDLE:
        case STATE_BALANCING:
        case STATE_FATAL:
            break;
        default:
            next_state = NO_CHANGE;
    }

    return next_state;
}

/*  _____                    _ _   _
 * |_   _| __ __ _ _ __  ___(_) |_(_) ___  _ __
 *   | || '__/ _` | '_ \/ __| | __| |/ _ \| '_ \
 *   | || | | (_| | | | \__ \ | |_| | (_) | | | |
 *   |_||_|  \__,_|_| |_|___/_|\__|_|\___/|_| |_|
 *
 *   __                  _   _
 *  / _|_   _ _ __   ___| |_(_) ___  _ __  ___
 * | |_| | | | '_ \ / __| __| |/ _ \| '_ \/ __|
 * |  _| |_| | | | | (__| |_| | (_) | | | \__ \
 * |_|  \__,_|_| |_|\___|\__|_|\___/|_| |_|___/
 */

// This function is called in 1 transition:
// 1. from init to idle
void init_to_idle(state_data_t *data) {
    /* Your Code Here */
    EAGLETRT_API_UNUSED(data);
}

// This function is called in 1 transition:
// 1. from init to fatal
void init_to_fatal(state_data_t *data) {
    /* Your Code Here */
    EAGLETRT_API_UNUSED(data);
}

// This function is called in 1 transition:
// 1. from flash to idle
void flash_to_idle(state_data_t *data) {
    /* Your Code Here */
    EAGLETRT_API_UNUSED(data);
}

// This function is called in 1 transition:
// 1. from flash to fatal
void flash_to_fatal(state_data_t *data) {
    /* Your Code Here */
    EAGLETRT_API_UNUSED(data);
}

// This function is called in 1 transition:
// 1. from idle to flash
void idle_to_flash(state_data_t *data) {
    /* Your Code Here */
    EAGLETRT_API_UNUSED(data);
}

// This function is called in 1 transition:
// 1. from idle to balancing
void idle_to_balancing(state_data_t *data) {
    /* Your Code Here */
    EAGLETRT_API_UNUSED(data);
}

// This function is called in 1 transition:
// 1. from idle to fatal
void idle_to_fatal(state_data_t *data) {
    /* Your Code Here */
    EAGLETRT_API_UNUSED(data);
}

// This function is called in 1 transition:
// 1. from balancing to idle
void balancing_to_idle(state_data_t *data) {
    /* Your Code Here */
    EAGLETRT_API_UNUSED(data);
    EAGLETRT_API_UNUSED(balancing_api_stop());
}

// This function is called in 1 transition:
// 1. from balancing to fatal
void balancing_to_fatal(state_data_t *data) {
    /* Your Code Here */
    EAGLETRT_API_UNUSED(data);
    EAGLETRT_API_UNUSED(balancing_api_stop());
}

// This function is called in 1 transition:
// 1. from fatal to flash
void fatal_to_flash(state_data_t *data) {
    /* Your Code Here */
    EAGLETRT_API_UNUSED(data);
}

/*  ____  _        _
 * / ___|| |_ __ _| |_ ___
 * \___ \| __/ _` | __/ _ \
 *  ___) | || (_| | ||  __/
 * |____/ \__\__,_|\__\___|
 *
 *
 *  _ __ ___   __ _ _ __   __ _  __ _  ___ _ __
 * | '_ ` _ \ / _` | '_ \ / _` |/ _` |/ _ \ '__|
 * | | | | | | (_| | | | | (_| | (_| |  __/ |
 * |_| |_| |_|\__,_|_| |_|\__,_|\__, |\___|_|
 *                              |___/
 */

state_t run_state(state_t cur_state, state_data_t *data) {
    state_t new_state = state_table[cur_state](data);
    if (new_state == NO_CHANGE) {
        new_state = cur_state;
    }

    if (new_state != cur_state) {
        logger_api_log(LOGGER_LEVEL_INFO, "[FSM] %s -> %s", state_names[cur_state], state_names[new_state]);
    }

    transition_func_t *transition = transition_table[cur_state][new_state];
    if (transition) {
        transition(data);
    }

    return new_state;
}

#ifdef TEST_MAIN
#include <unistd.h>
int main() {
    state_t cur_state = STATE_INIT;

    do {
        cur_state = run_state(cur_state, NULL);
        sleep(1);

    } while (1);

    return 0;
}
#endif
